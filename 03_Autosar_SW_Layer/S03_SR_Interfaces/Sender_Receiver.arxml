AUTOSAR XML (schema 00046)
package /Interfaces_Lab
  sender receiver interface SRI1
    data V1: sw-impl-policy=QUEUED, type=uint32, init-value=12
  application sw component type SWC1
    provide port Pprt1: provided-interface=SRI1
